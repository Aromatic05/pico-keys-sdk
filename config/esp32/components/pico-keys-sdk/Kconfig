## config/esp32/components/pico-keys-sdk/Kconfig
```kconfig
menu "Pico Keys SDK"

config PICOKEYS_ESP32_DEV_KEYS
    bool "Use reversible development root keys"
    default n
    depends on IDF_TARGET_ESP32S3
    help
        Use fixed development-only root keys instead of provisioning eFuse
        key blocks on first boot. This keeps a blank ESP32-S3 fully reversible
        while testing USB, FIDO, OpenPGP, Wi-Fi, and Bluetooth functionality.

        This mode is intentionally insecure and must never be used for a
        production security token.

config PICOKEYS_ESP32_WORKER_STACK_SIZE
    int "Card worker task stack size"
    default 16384
    range 8192 32768
    depends on IDF_TARGET_ESP32S3
    help
        Stack size in bytes for the transient APDU/CBOR worker task on ESP32-S3.
        Keep this independent of the number of USB interfaces; interface count
        is not a measure of cryptographic worker stack demand.

config PICOKEYS_ESP32_CORE_STACK_SIZE
    int "Main service task stack size"
    default 16384
    range 8192 32768
    depends on IDF_TARGET_ESP32S3
    help
        Stack size in bytes for the long-lived USB/button/flash service task on
        ESP32-S3. Keep it independent of the number of USB interfaces.

endmenu
```
